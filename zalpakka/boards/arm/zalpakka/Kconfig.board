## zalpakka/boards/arm/zalpakka/Kconfig.defconfig
```kconfig
if BOARD_Z_ALPAKKA

config BOARD
	default "z-alpakka"

config BT_CTLR
	default BT

config SOC_DCDC_NRF52X
	default y

endif
```

## zalpakka/boards/arm/zalpakka/zalpakka_defconfig
```kconfig
CONFIG_SOC_SERIES_NRF52X=y
CONFIG_SOC_NRF52832_QFAA=y
CONFIG_BOARD_Z_ALPAKKA=y
CONFIG_ARM_MPU=y
CONFIG_HW_STACK_PROTECTION=y
CONFIG_GPIO=y
CONFIG_SERIAL=y
CONFIG_CONSOLE=y
CONFIG_UART_CONSOLE=y
CONFIG_GPIO_AS_PINRESET=n
CONFIG_PINCTRL=y
CONFIG_NFCT_PINS_AS_GPIOS=y
```
